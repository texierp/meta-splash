## conf/layer.conf
```bitbake
# We have a conf and classes directory, add to BBPATH
BBPATH .= ":${LAYERDIR}"

# We have recipes-* directories, add to BBFILES
BBFILES += "${LAYERDIR}/recipes-*/*/*.bb \
            ${LAYERDIR}/recipes-*/*/*.bbappend"

BBFILE_COLLECTIONS += "meta-splash"
BBFILE_PATTERN_meta-splash = "^${LAYERDIR}/"
BBFILE_PRIORITY_meta-splash = "10"

LAYERDEPENDS_meta-splash = "core"
LAYERSERIES_COMPAT_meta-splash = "dunfell"

BBFILES_DYNAMIC += " \
    atmel:${LAYERDIR}/dynamic-layers/atmel/*/*/*.bb \
    atmel:${LAYERDIR}/dynamic-layers/atmel/*/*/*.bbappend \
"

IMAGE_BOOT_FILES_append_sama5d27-som1-ek-sd = " splash.bmp"
```
